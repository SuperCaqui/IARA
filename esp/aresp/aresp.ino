#include <ESP8266WiFi.h>
#include <Wire.h>
#include <Arduino.h>
#include <IRremoteESP8266.h>
#include <IRsend.h>

const char *ssid = "Comunavirus";
const char *password = "MestreMacaco2020";

IPAddress server(192,168,0,9);       // the fix IP address of the server
WiFiClient client;

// Set your Static IP address
IPAddress local_IP(192, 168, 0, 6);
// Set your Gateway IP address
IPAddress gateway(192, 168, 0, 1);

IPAddress subnet(255, 255, 255, 0);
IPAddress primaryDNS(198, 162, 0, 1);   //optional
IPAddress secondaryDNS(8, 8, 8, 8); //optional


const uint16_t kIrLed = 4;  // ESP8266 GPIO pin to use. Recommended: 4 (D2).

IRsend irsend(kIrLed);  // Set the GPIO to be used to sending the message.

uint16_t rawData[347] = {9070, 4508,  560, 562,  612, 530,  582, 536,  562, 1696,  582, 1674,  588,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 1674,  582};  // UNKNOWN 27C6CE79

uint16_t rawData2[347] = {9074, 4532,  560, 560,  562, 562,  560, 562,  562, 1696,  560, 1696,  560,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 560,  612};  // UNKNOWN 7968E20A


void setup() {
  irsend.begin();
  Serial.begin(115200);
  delay(10);

  if (!WiFi.config(local_IP, gateway, subnet, primaryDNS, secondaryDNS)) {
    Serial.println("STA Failed to configure");
  }

  conectar_wifi();
  print_conexao_wifi();
  
}

void loop() {
  conectar_server();
  
  String answer = receber();
  
  Serial.println("from server: " + answer);
  client.flush();
  if (answer == "4") {
    Serial.println("liga");
    irsend.sendRaw(rawData, 347, 20);
  } else if (answer == "5") {
    Serial.println("desliga");
    irsend.sendRaw(rawData2, 347, 20);
  }
}

void enviar(){
  client.println("birl Hello server! Are you sleeping?\r");
  Serial.println("Enviado ao servidor");
}

String receber(){
  String answer = client.readStringUntil('\r');
  Serial.println("Recebido do servidor");
  return answer;
}

void conectar_wifi(){
  // We start by connecting to a WiFi network
  Serial.println();
  Serial.println();
  Serial.print("Connecting to ");
  Serial.println(ssid);

  WiFi.begin(ssid, password);

  while (WiFi.status() != WL_CONNECTED) {
    Serial.print(".");
    delay(500);
  }
}

void print_conexao_wifi(){
  Serial.println("");
  Serial.println("WiFi connected");
  Serial.println("IP address: ");
  Serial.println(WiFi.localIP());
}

void conectar_server(){
  Serial.print("Conectando ao servidor");
  while (!client.connect(server, 8080)){
    Serial.print(".");
  }
}
